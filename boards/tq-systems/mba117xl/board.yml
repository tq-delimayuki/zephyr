## boards/tq-systems/mba117xl/board.yml
```yaml
board:
  name: mba117xl
  full_name: MBa117xL
  vendor: tq-systems
  socs:
    - name: mimxrt1176
  revision:
    format: "number"
    default: "200"
    revisions:
      - name: "200"
```
