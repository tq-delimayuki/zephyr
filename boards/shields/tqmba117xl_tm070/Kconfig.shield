## boards/shields/tqmba117xl_tm070/Kconfig.shield
```kconfig
# Copyright (c) 2025 TQ-Systems GmbH <license@tq-group.com>, D-82229 Seefeld, Germany.
# Author: Isaac L. L. Yuki
#
# SPDX-License-Identifier: Apache-2.0
#

config SHIELD_TQMBA117XL_TM070
	def_bool $(shields_list_contains,tqmba117xl_tm070)
```

## boards/tq/tqmba117xl/Kconfig
```kconfig
# Copyright (c) 2025 TQ-Systems GmbH <license@tq-group.com>, D-82229 Seefeld, Germany.
# Author: Isaac L. L. Yuki
#
# SPDX-License-Identifier: Apache-2.0
#

config BOARD_TQMBA117XL
	select BOARD_LATE_INIT_HOOK
	select SOC_LATE_INIT_HOOK
	select PINCTRL
```

## boards/tq/tqmba117xl/Kconfig.tqmba117xl
```kconfig
# Copyright (c) 2025 TQ-Systems GmbH <license@tq-group.com>, D-82229 Seefeld, Germany.
# Author: Isaac L. L. Yuki
#
# SPDX-License-Identifier: Apache-2.0
#

config BOARD_TQMBA117XL
	select SOC_PART_NUMBER_MIMXRT1176DVMAA
	select SOC_MIMXRT1176_CM7
```

## boards/tq/tqmba117xl/board.yml
```yaml
# Copyright (c) 2025 TQ-Systems GmbH <license@tq-group.com>, D-82229 Seefeld, Germany.
# Author: Isaac L. L. Yuki
#
# SPDX-License-Identifier: Apache-2.0
#

board:
  name: tqmba117xl
  full_name: TQMBa117xL
  vendor: tq
  socs:
    - name: mimxrt1176
  revision:
    format: "number"
    default: "200"
    revisions:
      - name: "200"
```
